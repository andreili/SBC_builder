// SPDX-License-Identifier: (GPL-2.0+ OR MIT)

/dts-v1/;
/plugin/;

&sfc {
	status = "okay";

	ports {
		#address-cells = <1>;
		#size-cells = <0>;

		flash@0 {
			compatible = "jedec,spi-nor";
			reg = <0>;
			spi-max-frequency = <100000000>;
			spi-rx-bus-width = <4>;
			spi-tx-bus-width = <1>;
		};
	};
};
